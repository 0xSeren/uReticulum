## firmware/heltec_v3/main/Kconfig.projbuild
```kconfig
menu "uReticulum Heltec V3"

    choice HELTEC_V3_MODE
        prompt "Firmware operating mode"
        default HELTEC_V3_MODE_TRANSPORT
        help
            Select whether this board runs as a standalone Reticulum
            transport node (default) or as a host-attached RNode bridge
            that Python Reticulum drives over USB serial.

        config HELTEC_V3_MODE_TRANSPORT
            bool "Transport node (autonomous)"
            help
                Boots into uReticulum with its own Identity, announces a
                local destination, and opens Links to peers over LoRa.

        config HELTEC_V3_MODE_RNODE
            bool "RNode bridge over USB UART"
            help
                Exposes the SX1262 to a USB host via the RNode KISS
                serial protocol so Python RNS (nomadnet, rnsd, etc.)
                can drive it as an rnode interface. The uReticulum stack
                is not started in this mode; the board is a dumb radio.

        config HELTEC_V3_MODE_RNODE_BLE
            bool "RNode bridge over Bluetooth LE"
            help
                Same KISS bridge as the UART variant, but wrapped in a
                Nordic UART Service GATT profile so Python RNS can
                connect over BLE with `port = ble://RNode XXXX`. Useful
                for driving the radio from a phone or tablet. Pulls in
                NimBLE and adds ~300 KB to the firmware image.

    endchoice

endmenu

menu "uReticulum LoRa"

    config LORA_FREQ_MHZ_X10
        int "Frequency (MHz x10, e.g. 9150 = 915.0 MHz)"
        default 9150
        help
            LoRa center frequency in tenths of MHz. Multiply your desired
            frequency by 10: 915.0 MHz = 9150, 868.0 MHz = 8680,
            433.0 MHz = 4330. Tenths allow sub-MHz precision without
            floating point in Kconfig.

    config LORA_BANDWIDTH_KHZ
        int "Bandwidth (kHz)"
        default 125
        range 8 500
        help
            LoRa bandwidth in kHz. Common values: 125, 250, 500.
            Must match the peer's bandwidth.

    config LORA_SPREADING_FACTOR
        int "Spreading factor"
        default 9
        range 5 12
        help
            LoRa spreading factor (5-12). Higher SF = longer range but
            slower. SF9 is a good default for Reticulum on 915 MHz.

    config LORA_CODING_RATE
        int "Coding rate"
        default 7
        range 5 8
        help
            LoRa coding rate (5-8). Higher = more error correction but
            slower. 7 matches upstream RNode defaults.

    config LORA_TX_POWER_DBM
        int "TX power (dBm)"
        default 14
        range 2 22
        help
            Transmit power in dBm. SX1262 supports 2-22 dBm.
            14 dBm is a reasonable default for short-range testing.

    config LORA_PREAMBLE_LENGTH
        int "Preamble length (symbols)"
        default 8
        range 4 65535
        help
            LoRa preamble length in symbols. 8 is the standard default.

endmenu

menu "uReticulum WiFi + OTA"

    config WIFI_DEFAULT_SSID
        string "Default WiFi SSID"
        default ""
        help
            WiFi AP to connect to in STA mode. Leave empty to disable
            WiFi. Can be overridden at runtime via NVS.

    config WIFI_DEFAULT_PSK
        string "Default WiFi PSK"
        default ""
        help
            WiFi password. Can be overridden at runtime via NVS.

    config TCP_INTERFACE_HOST
        string "Reticulum TCP peer host"
        default ""
        help
            Hostname or IP of an upstream Reticulum node (rnsd) to
            connect to over WiFi. Leave empty to disable the TCP
            interface. The transport node will bridge LoRa ↔ TCP.

    config TCP_INTERFACE_PORT
        int "Reticulum TCP peer port"
        default 4965
        help
            TCP port of the upstream Reticulum node.

    config OTA_DEFAULT_URL
        string "Default OTA firmware URL"
        default ""
        help
            HTTP URL to pull firmware from on OTA update. Example:
            http://192.168.1.100:8080/ureticulum.bin

endmenu
```

## firmware/heltec_v3/sdkconfig.defaults
```kconfig
# ESP-IDF defaults for uReticulum on Heltec V3.
# These get baked into sdkconfig on first idf.py build.

CONFIG_IDF_TARGET="esp32s3"

# Enable C++ exceptions — uReticulum throws on a few error paths.
CONFIG_COMPILER_CXX_EXCEPTIONS=y
CONFIG_COMPILER_CXX_EXCEPTIONS_EMG_POOL_SIZE=0

# Heltec V3 has a CP2102 USB-UART bridge wired to UART0 — not native
# ESP32-S3 USB CDC. Use default UART console so the CP2102 carries logs.
CONFIG_ESP_CONSOLE_UART_DEFAULT=y

# FreeRTOS config — recursive mutexes are used by Transport.
CONFIG_FREERTOS_USE_TIMERS=y
CONFIG_FREERTOS_HZ=1000

# Runtime statistics — needed so we can ask FreeRTOS how much time each
# task has spent running. Used by the firmware to display CPU idle %.
CONFIG_FREERTOS_USE_TRACE_FACILITY=y
CONFIG_FREERTOS_GENERATE_RUN_TIME_STATS=y
CONFIG_FREERTOS_USE_STATS_FORMATTING_FUNCTIONS=y

# Stack and task tuning. Reticulum loop is spawned with 8192 words of
# stack from app_main; the main task itself doesn't need to be huge.
CONFIG_ESP_MAIN_TASK_STACK_SIZE=4096

# Enable mbedTLS algorithms uReticulum needs (these are usually on by
# default but listed for clarity).
CONFIG_MBEDTLS_HARDWARE_AES=y
CONFIG_MBEDTLS_HARDWARE_SHA=y
CONFIG_MBEDTLS_HKDF_C=y

# Optimisation: -Os keeps flash usage down, OK for our workload.
CONFIG_COMPILER_OPTIMIZATION_SIZE=y

# Power management — dynamic frequency scaling + tickless idle lets the
# MCU drop to light sleep between DIO1 / timer interrupts. On top of the
# already-~99% WFI idle we see without PM, this should cut the MCU's
# contribution to total power by another ~50%.
CONFIG_PM_ENABLE=y
CONFIG_PM_DFS_INIT_AUTO=y
CONFIG_FREERTOS_USE_TICKLESS_IDLE=y
CONFIG_FREERTOS_IDLE_TIME_BEFORE_SLEEP=3

# Allow the MCU to scale all the way down when idle. Max freq is bound
# by the CPU clock we selected; min is 10 MHz; light sleep is entered
# whenever both are OK.
CONFIG_ESP_DEFAULT_CPU_FREQ_MHZ_160=y

# Heltec V3 has 8MB flash (W25Q64). The default 2MB autodetect is
# wrong and too small for OTA dual-slot partitions.
CONFIG_ESPTOOLPY_FLASHSIZE_8MB=y
CONFIG_ESPTOOLPY_FLASHSIZE="8MB"

# Custom partition table with two OTA slots (~1.75MB each).
CONFIG_PARTITION_TABLE_CUSTOM=y
CONFIG_PARTITION_TABLE_CUSTOM_FILENAME="partitions.csv"

# OTA rollback: if new firmware doesn't mark itself valid within 30s
# the bootloader reverts to the previous slot.
CONFIG_BOOTLOADER_APP_ROLLBACK_ENABLE=y

# Allow OTA over plain HTTP (no TLS) for LAN update servers.
CONFIG_ESP_HTTPS_OTA_ALLOW_HTTP=y
```
